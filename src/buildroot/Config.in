## src/buildroot/Config.in
```kconfig
menu "RaSCSI Target packages"

	source "$BR2_EXTERNAL_RASCSI_TREE_PATH/package/rascsi/Config.in"

endmenu
```

## src/buildroot/package/rascsi/Config.in
```kconfig
config BR2_PACKAGE_RASCSI
	bool "rascsi_enabled"
	select BR2_PACKAGE_SPDLOG
	select BR2_PACKAGE_ZLIB
	select BR2_INSTALL_LIBSTDCPP
	select BR2_TOOLCHAIN_HAS_THREADS
	select BR2_TOOLCHAIN_BUILDROOT_LOCALE
	select BR2_PACKAGE_FMT
	select BR2_PACKAGE_LIBPCAP
	help
	  This package builds the RaSCSI service and includes
	  it in the generated file system image.
	
	  http://www.rascsi.com

comment "rascsi needs a glibc toolchain w/ C++"
```
